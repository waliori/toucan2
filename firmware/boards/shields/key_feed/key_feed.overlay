// Add-on shield for the central: a dedicated USB CDC ACM port (next to Studio's) that carries the
// live key feed read by trainer/ (see src/key_feed.c). Not a console, no logging goes through it.
&zephyr_udc0 {
    feed_uart: feed_uart {
        compatible = "zephyr,cdc-acm-uart";
    };
};
