## firmware/Kconfig
```kconfig
config ZMK_KEY_FEED
    bool "Stream key positions and layer changes on a dedicated USB serial port (for trainer/)"
    select SERIAL
    select UART_INTERRUPT_DRIVEN
    select UART_LINE_CTRL
    select USB_DEVICE_STACK
    select USB_CDC_ACM
    default n
```

## firmware/config/west.yml
```yaml
manifest:
  remotes:
    - name: zmkfirmware
      url-base: https://github.com/zmkfirmware
    - name: beekeeb
      url-base: https://github.com/beekeeb
    - name: caksoylar
      url-base: https://github.com/caksoylar
    - name: t-ogura
      url-base: https://github.com/t-ogura
  projects:
    - name: zmk
      remote: zmkfirmware
      revision: acfd8e5ea76cf23ad1c9b6b99848f97a95224257  # v0.3-branch (same line beekeeb builds from)
      import: app/west.yml
    - name: zephyr
      remote: zmkfirmware
      revision: dacab4875df72109b96cc8977547a0dc04875bcd  # v3.5.0+zmk-fixes
      import:
        name-blocklist:
          - ci-tools
          - hal_altera
          - hal_cypress
          - hal_infineon
          - hal_microchip
          - hal_nxp
          - hal_openisa
          - hal_silabs
          - hal_xtensa
          - hal_st
          - hal_ti
          - loramac-node
          - mcuboot
          - mcumgr
          - net-tools
          - openthread
          - edtt
          - trusted-firmware-m
    # Toucan2 shield (left/right halves) + its trackpad driver and zoom processor
    - name: zmk-keyboard-toucan2
      remote: beekeeb
      revision: 6882c95bec5be89988e90feb621f78a7511e9ed7  # main 2026-07-28
    - name: zmk_driver_azoteq
      remote: beekeeb
      revision: c329f309b7481e5723603550b15f48e24d0c8a6a  # main 2026-07-11
    - name: zmk-input-zoom
      remote: beekeeb
      revision: 91bbe0c0e02145da50c9df798489479d28be1804  # main 2026-06-23
    - name: zmk-rgbled-widget
      remote: caksoylar
      revision: 8756cb7b8114069fa3c25c6f6c990f24988fceff  # v0.3
    # Prospector scanner protocol: the central broadcasts its status in BLE advertisements
    - name: prospector-zmk-module
      remote: t-ogura
      revision: 72a71aeea816eb0f86ffc5b108b267076ce5f0af  # v2.2.3 (keyboard side builds on the ZMK v0.3 line)
  self:
    path: config
```

## scanner/config/west.yml
```yaml
manifest:
  remotes:
    - name: zmkfirmware
      url-base: https://github.com/zmkfirmware
    - name: t-ogura
      url-base: https://github.com/t-ogura
  projects:
    # the scanner needs ZMK main / Zephyr 4 (same pins zmk-nix uses for its own builds)
    - name: zmk
      remote: zmkfirmware
      revision: 4dd95d7840eb3d5a3f59bb29fbf1ab054715ef85  # main 2026-10-09
      import: app/west.yml
    - name: zephyr
      remote: zmkfirmware
      revision: 10ba6d0cb38bc3d258775d27982f707599320085  # v4.1.0+zmk-fixes
      import:
        name-blocklist:
          - ci-tools
          - hal_altera
          - hal_cypress
          - hal_infineon
          - hal_microchip
          - hal_nxp
          - hal_openisa
          - hal_silabs
          - hal_xtensa
          - hal_st
          - hal_ti
          - loramac-node
          - mcuboot
          - mcumgr
          - net-tools
          - openthread
          - edtt
          - trusted-firmware-m
    - name: prospector-zmk-module
      remote: t-ogura
      revision: 72a71aeea816eb0f86ffc5b108b267076ce5f0af  # v2.2.3
  self:
    path: config
```
